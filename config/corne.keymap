// Copyright 2021 Manna Harbour
// https://github.com/manna-harbour/miryoku

#include "../miryoku/custom_config.h"
#include "../miryoku/mapping/42/corne.h"
#include "../miryoku/miryoku.dtsi"

&pro_micro_spi {
    status = "okay";
    nice_view_spi: nice_view_spi {
        compatible = "nicekeyboards,nice-view-spi";
    };
};
